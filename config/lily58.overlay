/ {
    chosen {
        zmk,display = &oled;
    };
};

&pro_micro_i2c {
    status = "okay";

    /delete-node/ ssd1306@3c;

    oled: sh1106@3c {
        compatible = "solomon,ssd1306fb";
        reg = <0x3c>;

        width = <128>;
        height = <64>;

        segment-offset = <2>;
        page-offset = <0>;
        display-offset = <0>;

        multiplex-ratio = <63>;

        prechargep = <0x22>;  
        com-invdir;
        segment-remap;

        label = "DISPLAY";
    };
};
